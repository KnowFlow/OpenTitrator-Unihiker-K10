  page += F("function text(id,v){var e=document.getElementById(id);if(e)e.textContent=v}");
  page += F("function html(id,v){var e=document.getElementById(id);if(e)e.innerHTML=v}");
  page += F("function sessionToken(){return sessionStorage.getItem('k10_session')||''}function showLogin(){document.getElementById('loginPanel').style.display='block';document.getElementById('sessionPanel').style.display='none'}function showSession(){document.getElementById('loginPanel').style.display='none';document.getElementById('sessionPanel').style.display='block'}function authMessage(v){text('authMessage',v)}");
  page += F("async function apiPost(path,form,allowAnonymous){const headers={'Content-Type':'application/x-www-form-urlencoded;charset=UTF-8'};const token=sessionToken();if(token)headers['X-Session-Token']=token;if(!token&&!allowAnonymous&&path!=='/login'&&path!=='/recover'){showLogin();throw new Error('Login required')}const response=await fetch(path,{method:'POST',headers,body:new URLSearchParams(form)});const data=await response.json();if(response.status===401){sessionStorage.removeItem('k10_session');showLogin()}if(response.status===403)authMessage('Request is not permitted in the current state.');if(response.status===429)throw new Error('Too many attempts. Try again later.');if(!response.ok)throw new Error(data.message||data.code||'Request failed');return data}");
  page += F("var curve=[],curveStart=0,eqpManual=null,lastPlot=[];function num(v){return Number(v||0)}function curveTarget(d){return d.endpoint==='mV'?num(d.target_mv):num(d.target_ph)}");
  page += F("function recordCurve(d){if(!d.adc_ok)return;var now=Date.now();if(!curveStart)curveStart=now;curve.push({ts:new Date(now).toISOString(),elapsed_s:(now-curveStart)/1000,ph:num(d.ph),mv:num(d.mv),used_g:num(d.used_g),endpoint_used_g:num(d.endpoint_used_g),sample_g:num(d.sample_delivered_g),endpoint:d.endpoint,target:curveTarget(d),trend:d.mode,state:d.state,pump:!!d.pump,pulse_ms:num(d.pump_pulse_ms),status:d.status,method:d.method,result_value:num(d.result_value),result_unit:d.result_unit,result_formula:d.result_formula,blank_g:num(d.blank_g),titrant_density:num(d.titrant_density),sample_density:num(d.sample_density),auto_eqp:!!d.auto_eqp,eqp_reached:!!d.eqp_reached,eqp_used_g:num(d.eqp_used_g),eqp_signal:num(d.eqp_signal),eqp_slope:num(d.eqp_slope),manual_factor:num(d.manual_factor)});var cutoff=now-86400000;while(curve.length&&new Date(curve[0].ts).getTime()<cutoff)curve.shift();drawCurve()}");
  page += F("var runRecord=null,recordDb=null;function recordCopy(v){return JSON.parse(JSON.stringify(v))}function readRecordMetadata(){return{sampleId:document.getElementById('recordSampleId').value,batchReference:document.getElementById('recordBatchReference').value,operator:document.getElementById('recordOperator').value,notes:document.getElementById('recordNotes').value}}function newRunRecord(){runRecord={schemaVersion:1,recordStatus:'draft',metadata:readRecordMetadata(),startedAt:null,finishedAt:null,methodSnapshot:null,deviceSnapshot:null,confirmed:null,final:null,points:[]};renderRunRecord()}function renderRunRecord(){text('recordStatus',runRecord?runRecord.recordStatus.charAt(0).toUpperCase()+runRecord.recordStatus.slice(1):'Draft');text('recordPoints',runRecord?runRecord.points.length+' points':'0 points')}function recordMethodSnapshot(d){return{method:d.method,methodLabel:d.method_label,endpoint:d.endpoint,targetPh:d.target_ph,targetMv:d.target_mv,maxGrams:d.max_g,controlBand:d.control_band,stableDelta:d.stable_delta,holdSeconds:d.hold_s,minSettleSeconds:d.min_settle_s,maxSettleSeconds:d.max_settle_s,titrant:d.titrant,titrantM:d.titrant_m,resultFormula:d.result_formula,blankGrams:d.blank_g,titrantDensity:d.titrant_density,sampleDensity:d.sample_density,manualFactor:d.manual_factor}}function recordDeviceSnapshot(d){return{network:d.network,ip:d.ip,ap_ip:d.ap_ip,sta_ip:d.sta_ip,sta_connected:d.sta_connected,ota:d.ota,ota_safety_lock:d.ota_safety_lock,status:d.status,titrantGps:d.titrant_gps,sampleGps:d.sample_gps,titrantRunUs:d.titrant_run_us,sampleRunUs:d.sample_run_us,titrantDosePercent:d.titrant_dose_pct,scaleFactor:d.scale_factor,phCalibrationStatus:d.ph_cal_status,phSlopePercent:d.ph_slope_percent,phOffset7Mv:d.ph_offset7_mv}}function recordPoint(){var p=recordCopy(curve[curve.length-1]);p.elapsed_s=runRecord.points.length?(new Date(p.ts)-new Date(runRecord.startedAt))/1000:0;return p}function recordFinal(d){return{state:d.state,status:d.status,resultValue:d.result_value,resultUnit:d.result_unit,usedGrams:d.used_g,endpointUsedGrams:d.endpoint_used_g,sampleDeliveredGrams:d.sample_delivered_g,eqpReached:d.eqp_reached,eqpUsedGrams:d.eqp_used_g,eqpSignal:d.eqp_signal,eqpSlope:d.eqp_slope}}function observeRunRecord(d){var active=['SAMPLE','WARMUP','RUN','DOSE','WAIT','PAUSE'].indexOf(d.state)>=0;if(active&&!runRecord)newRunRecord();if(active&&runRecord&&!runRecord.startedAt){runRecord.recordStatus='running';runRecord.startedAt=new Date().toISOString();runRecord.methodSnapshot=recordCopy(recordMethodSnapshot(d));runRecord.deviceSnapshot=recordCopy(recordDeviceSnapshot(d));runRecord.points=d.adc_ok&&curve.length?[recordPoint()]:[]}else if(runRecord&&runRecord.startedAt&&!runRecord.final&&d.adc_ok&&curve.length){runRecord.points.push(recordPoint())}if(runRecord&&runRecord.startedAt&&!runRecord.final){var completed=d.state==='DONE'&&(d.status==='Target reached'||d.status==='Equivalence point');var aborted=d.state==='ERROR'||d.status==='Emergency stop'||(!active&&d.state!=='DONE');if(completed||aborted){runRecord.recordStatus=completed?'completed':'aborted';runRecord.confirmed=completed;runRecord.finishedAt=new Date().toISOString();runRecord.final=recordCopy(recordFinal(d));saveFinalRecord(runRecord)}}renderRunRecord()}");
  page += F("function openRecordDb(){return new Promise(function(resolve,reject){if(recordDb)return resolve(recordDb);var request=indexedDB.open('k10-titration-records',1);request.onupgradeneeded=function(){if(!request.result.objectStoreNames.contains('runs'))request.result.createObjectStore('runs',{keyPath:'id'})};request.onsuccess=function(){recordDb=request.result;resolve(recordDb)};request.onerror=function(){reject(request.error)}})}function savedSummary(r){var m=r.metadata||{};return(r.finishedAt||r.savedAt||'').replace('T',' ').slice(0,19)+' / '+(m.sampleId||'unnamed')+' / '+r.recordStatus}function refreshSavedRecords(){openRecordDb().then(function(db){var request=db.transaction('runs').objectStore('runs').getAll();request.onsuccess=function(){var rows=request.result.sort(function(a,b){return String(b.savedAt).localeCompare(String(a.savedAt))}),select=document.getElementById('savedRecordSelect');select.innerHTML='<option value=&quot;&quot;>Select saved record</option>';rows.forEach(function(r){var option=document.createElement('option');option.value=r.id;option.textContent=savedSummary(r);select.appendChild(option)});text('savedRecordInfo',rows.length+' saved records in this browser.')}}).catch(function(){text('savedRecordInfo','Local record storage is unavailable.')})}function saveFinalRecord(record){if(!record||!record.final)return;openRecordDb().then(function(db){var copy=recordCopy(record);copy.id=copy.id||('run-'+Date.now()+'-'+Math.random().toString(16).slice(2));copy.savedAt=new Date().toISOString();record.id=copy.id;var tx=db.transaction('runs','readwrite'),store=tx.objectStore('runs');store.put(copy);store.getAll().onsuccess=function(e){e.target.result.sort(function(a,b){return String(b.savedAt).localeCompare(String(a.savedAt))}).slice(50).forEach(function(old){store.delete(old.id)})};tx.oncomplete=refreshSavedRecords;tx.onerror=function(){text('savedRecordInfo','Could not save this local record.')}}).catch(function(){text('savedRecordInfo','Local record storage is unavailable.')})}function loadSavedRecord(){var id=document.getElementById('savedRecordSelect').value;if(!id)return;openRecordDb().then(function(db){var request=db.transaction('runs').objectStore('runs').get(id);request.onsuccess=function(){if(!request.result)return;runRecord=recordCopy(request.result);curve=recordCopy(runRecord.points||[]);curveStart=curve.length?Date.now()-num(curve[curve.length-1].elapsed_s)*1000:0;eqpManual=null;renderRunRecord();drawCurve();text('savedRecordInfo','Loaded local record.')}})}function deleteSavedRecord(){var id=document.getElementById('savedRecordSelect').value;if(!id)return;openRecordDb().then(function(db){var tx=db.transaction('runs','readwrite');tx.objectStore('runs').delete(id);tx.oncomplete=refreshSavedRecords})}");
  page += F("var replayPoints=null;function analyzeReplay(points){var empty=function(reason){return{quality:'insufficient',reason:reason,candidate:null,slopes:[]}};if(!Array.isArray(points))return empty('No curve points available.');var normalized=[];points.forEach(function(p){var endpoint=p.endpoint==='mV'?'mV':'pH',used=num(p.used_g),signal=num(endpoint==='mV'?p.mv:p.ph);if(isFinite(used)&&isFinite(signal))normalized.push({endpoint:endpoint,used_g:used,signal:signal,elapsed_s:num(p.elapsed_s),ph:num(p.ph),mv:num(p.mv)})});if(normalized.length<3)return empty('Need at least 3 usable points.');var endpoint=normalized[0].endpoint;if(normalized.some(function(p){return p.endpoint!==endpoint}))return empty('Mixed pH and mV records cannot be replayed together.');normalized.sort(function(a,b){return a.used_g-b.used_g||a.elapsed_s-b.elapsed_s});var dose=[];normalized.forEach(function(p){if(dose.length&&Math.abs(p.used_g-dose[dose.length-1].used_g)<0.01)dose[dose.length-1]=p;else dose.push(p)});if(dose.length<3)return empty('Need at least 3 separated dose-change points.');var slopes=[];for(var i=1;i<dose.length-1;i++){var prev=dose[i-1],next=dose[i+1],span=next.used_g-prev.used_g;if(span>0)slopes.push({index:i,used_g:dose[i].used_g,elapsed_s:dose[i].elapsed_s,signal:dose[i].signal,ph:dose[i].ph,mv:dose[i].mv,endpoint:endpoint,slope:Math.abs((next.signal-prev.signal)/(next.used_g-prev.used_g))})}if(!slopes.length)return empty('No positive dose span is available.');var best=slopes[0];slopes.forEach(function(s){if(s.slope>best.slope)best=s});var quality=slopes.length>=5?'high':slopes.length>=2?'review':'insufficient',reason=quality==='high'?'Enough local slopes for review.':quality==='review'?'Limited slope count; review the curve manually.':'Only one local slope; add more dose changes.';return{quality:quality,reason:reason,candidate:best,slopes:slopes}}");
  page += F("function replayText(result){if(!result.candidate)return 'Replay: '+result.reason;var c=result.candidate,v=c.endpoint==='mV'?c.signal.toFixed(0)+' mV':c.signal.toFixed(2)+' pH';return 'Replay '+result.quality+': EQP '+c.used_g.toFixed(2)+' g, '+v+', centered slope '+c.slope.toFixed(c.endpoint==='mV'?1:3)+' '+c.endpoint+'/g. '+result.reason}function runReplayAnalysis(){text('replayInfo',replayText(analyzeReplay(replayPoints||curve)))}function importReplayRecord(file){if(!file)return;var reader=new FileReader();reader.onload=function(){try{var data=JSON.parse(reader.result),points=data&&data.record&&Array.isArray(data.record.points)?data.record.points:data&&Array.isArray(data.points)?data.points:null;if(!points)throw new Error('JSON does not contain record points.');replayPoints=recordCopy(points);text('replayInfo','Imported '+replayPoints.length+' points locally. Click Replay analysis.')}catch(e){replayPoints=null;text('replayInfo','Import failed: '+e.message)}};reader.readAsText(file)}");
  page += F("function dosePoints(){var pts=[];curve.forEach(function(p){if(!isFinite(p.used_g))return;if(pts.length&&Math.abs(p.used_g-pts[pts.length-1].used_g)<0.01){pts[pts.length-1]=p}else pts.push(p)});return pts}");
  page += F("function analyzeEqp(){var pts=dosePoints();if(pts.length<3)return null;var yk=pts[pts.length-1].endpoint==='mV'?'mv':'ph',best=null;for(var i=1;i<pts.length;i++){var dx=pts[i].used_g-pts[i-1].used_g;if(Math.abs(dx)<0.01)continue;var dy=pts[i][yk]-pts[i-1][yk],s=Math.abs(dy/dx);if(!best||s>best.slope){best={mode:'auto',index:i,used_g:pts[i].used_g,elapsed_s:pts[i].elapsed_s,signal:pts[i][yk],ph:pts[i].ph,mv:pts[i].mv,endpoint:pts[i].endpoint,slope:s}}}return best}");
  page += F("function currentEqp(){var a=analyzeEqp();return eqpManual||a}function eqpText(e){if(!e)return 'EQP waits for at least 3 dose-change points.';var v=e.endpoint==='mV'?e.signal.toFixed(0)+' mV':e.signal.toFixed(2)+' pH';return (e.mode==='manual'?'Manual':'Auto')+' EQP: '+e.used_g.toFixed(2)+' g, '+v+', slope '+e.slope.toFixed(e.endpoint==='mV'?1:3)+' '+e.endpoint+'/g'}");
  page += F("function median(a){if(!a.length)return 0;var b=a.slice().sort(function(x,y){return x-y}),m=Math.floor(b.length/2);return b.length%2?b[m]:(b[m-1]+b[m])/2}function clamp(v,a,b){return Math.max(a,Math.min(b,v))}");
  page += F("function suggestParams(){var pts=dosePoints();if(pts.length<4){text('learnInfo','Need at least 4 dose-change points before recommending parameters.');return}var ep=pts[pts.length-1].endpoint,yk=ep==='mV'?'mv':'ph',dose=[],slope=[],timeSlope=[];for(var i=1;i<pts.length;i++){var dx=pts[i].used_g-pts[i-1].used_g,dy=pts[i][yk]-pts[i-1][yk],dt=pts[i].elapsed_s-pts[i-1].elapsed_s;if(Math.abs(dx)>=0.01){dose.push(Math.abs(dx));slope.push(Math.abs(dy/dx))}if(dt>0)timeSlope.push(Math.abs(dy/dt))}if(!slope.length){text('learnInfo','Need changing used g values before recommending parameters.');return}var md=median(dose),ms=Math.max.apply(null,slope),drift=median(timeSlope);var mv=ep==='mV';var band=mv?clamp(ms*md*2.0,10,120):clamp(ms*md*2.0,0.10,1.50);var stable=mv?clamp(Math.max(drift*1.5,0.3),0.3,5.0):clamp(Math.max(drift*1.5,0.003),0.003,0.050);var steep=mv?ms>80:ms>2.0;var minSettle=steep?10:5,maxSettle=steep?60:30;var msg='Suggested: control band '+band.toFixed(mv?1:3)+', stable delta/s '+stable.toFixed(mv?1:3)+', min/max settle '+minSettle+'/'+maxSettle+' s';msg+=' from max slope '+ms.toFixed(mv?1:3)+' '+ep+'/g and median dose '+md.toFixed(2)+' g. Review before applying in Admin.';text('learnInfo',msg)}");
  page += F("function drawCurve(){var c=document.getElementById('curveCanvas');if(!c)return;var r=c.getBoundingClientRect();if(r.width>0&&c.width!==Math.floor(r.width)){c.width=Math.floor(r.width);c.height=260}var g=c.getContext('2d'),w=c.width,h=c.height,l=58,t=18,ri=18,b=36;lastPlot=[];g.clearRect(0,0,w,h);g.fillStyle='#071014';g.fillRect(0,0,w,h);g.strokeStyle='#244c59';g.lineWidth=1;g.strokeRect(l,t,w-l-ri,h-t-b);text('curveInfo',curve.length+' points');text('eqpInfo',eqpText(currentEqp()));if(curve.length<2){drawDeriv();return}var xs=document.getElementById('chartX'),ys=document.getElementById('chartY');var xk=xs&&xs.value==='used'?'used_g':'elapsed_s';var ysel=ys?ys.value:'auto';var yk=ysel==='auto'?(curve[curve.length-1].endpoint==='mV'?'mv':'ph'):ysel;var yl=yk==='ph'?'pH':'mV';var view=curve;if(xk==='elapsed_s'){var latest=curve[curve.length-1].elapsed_s,from=Math.max(curve[0].elapsed_s,latest-600);view=curve.filter(function(p){return p.elapsed_s>=from})}var pts=[];view.forEach(function(p){if(xk==='used_g'&&pts.length&&Math.abs(p.used_g-pts[pts.length-1].used_g)<0.01){pts[pts.length-1]=p}else pts.push(p)});var info=curve.length+' saved / '+pts.length+' shown'+(xk==='elapsed_s'?' / last 10 min':'');text('curveInfo',info);if(pts.length<2){text('curveInfo',info+' / waiting for '+(xk==='used_g'?'dose change':'more samples'));drawDeriv();return}var smooth=pts.map(function(p,i){var s=0,n=0;for(var j=Math.max(0,i-2);j<=Math.min(pts.length-1,i+2);j++){s+=pts[j][yk];n++}var q=Object.assign({},p);q[yk]=s/n;return q});var last=pts[pts.length-1],lastSmooth=smooth[smooth.length-1],tgt=last.target,tol=yk==='mv'?5:0.05;var minx=pts[0][xk],maxx=pts[0][xk],miny=pts[0][yk],maxy=miny;pts.concat(smooth).forEach(function(p){if(p[xk]<minx)minx=p[xk];if(p[xk]>maxx)maxx=p[xk];if(p[yk]<miny)miny=p[yk];if(p[yk]>maxy)maxy=p[yk]});if(yk==='ph'){miny=1;maxy=14}else{if(tgt>0){miny=Math.min(miny,tgt-tol);maxy=Math.max(maxy,tgt+tol)}if(maxy===miny)maxy=miny+1;var ypad=(maxy-miny)*0.10;miny-=ypad;maxy+=ypad}if(maxx===minx)maxx=minx+1;var px=function(x){return l+(x-minx)/(maxx-minx)*(w-l-ri)};var py=function(y){return h-b-(y-miny)/(maxy-miny)*(h-t-b)};if(yk==='ph'){[{a:4,b:6,c:'rgba(85,190,255,0.10)'},{a:6,b:8,c:'rgba(103,240,154,0.11)'},{a:8,b:10,c:'rgba(255,209,92,0.10)'}].forEach(function(z){g.fillStyle=z.c;g.fillRect(l,py(z.b),w-l-ri,py(z.a)-py(z.b))});[4,7,10].forEach(function(v){g.strokeStyle='rgba(141,176,189,0.25)';g.lineWidth=1;g.beginPath();g.moveTo(l,py(v));g.lineTo(w-ri,py(v));g.stroke();g.fillStyle='#8db0bd';g.font='10px Verdana';g.fillText(String(v),l-18,py(v)+3)})}if(tgt>0){var ty1=py(tgt+tol),ty2=py(tgt-tol),ty=py(tgt);g.fillStyle='rgba(255,77,77,0.12)';g.fillRect(l,Math.min(ty1,ty2),w-l-ri,Math.abs(ty2-ty1));g.strokeStyle='#ff4d4d';g.lineWidth=1;g.setLineDash([6,4]);g.beginPath();g.moveTo(l,ty);g.lineTo(w-ri,ty);g.stroke();g.setLineDash([]);g.fillStyle='#ff6b6b';g.font='11px Verdana';g.fillText('target '+tgt.toFixed(yk==='ph'?2:0)+' ±'+tol.toFixed(yk==='ph'?2:0),w-ri-120,ty-5)}g.strokeStyle='rgba(103,240,154,0.28)';g.lineWidth=1;g.beginPath();pts.forEach(function(p,i){var x=px(p[xk]),y=py(p[yk]);lastPlot.push({x:x,y:y,p:p,yk:yk});if(i)g.lineTo(x,y);else g.moveTo(x,y)});g.stroke();g.strokeStyle='#67f09a';g.lineWidth=3;g.beginPath();smooth.forEach(function(p,i){var x=px(p[xk]),y=py(p[yk]);if(i)g.lineTo(x,y);else g.moveTo(x,y)});g.stroke();var lx=px(last[xk]),ly=py(lastSmooth[yk]);g.fillStyle='#eaf7ff';g.strokeStyle='#071014';g.lineWidth=2;g.beginPath();g.arc(lx,ly,5,0,6.283);g.fill();g.stroke();var err=last[yk]-tgt,tag=(yk==='ph'?last[yk].toFixed(2):last[yk].toFixed(0))+' '+yl+(tgt>0?' / Δ '+(err>=0?'+':'')+err.toFixed(yk==='ph'?2:0):'');g.fillStyle='rgba(7,16,20,0.86)';g.fillRect(Math.max(l,lx-154),Math.max(t,ly-28),150,22);g.fillStyle='#eaf7ff';g.font='12px Verdana';g.fillText(tag,Math.max(l+4,lx-150),Math.max(t+14,ly-13));var e=currentEqp();if(e){var ex=px(xk==='used_g'?e.used_g:e.elapsed_s),ey=py(yk==='mv'?e.mv:e.ph);if(ex>=l&&ex<=w-ri){g.strokeStyle='#ffd15c';g.fillStyle='#ffd15c';g.lineWidth=1;g.beginPath();g.moveTo(ex,t);g.lineTo(ex,h-b);g.stroke();g.beginPath();g.arc(ex,ey,5,0,6.283);g.fill()}}var lastPump=false;var doseCount=0;view.forEach(function(p){if(p.pump&&!lastPump&&p[xk]>=minx&&p[xk]<=maxx){var dx=px(p[xk]);g.strokeStyle='rgba(255,210,74,0.4)';g.lineWidth=1;g.setLineDash([2,6]);g.beginPath();g.moveTo(dx,t);g.lineTo(dx,h-b);g.stroke();g.setLineDash([]);if(++doseCount<=8){g.fillStyle='rgba(255,210,74,0.7)';g.font='9px Verdana';g.fillText((p.pulse_ms||0)+'ms',dx+2,t+10)}}lastPump=p.pump});g.fillStyle='#8db0bd';g.font='12px Verdana';g.fillText(xk==='used_g'?'used g':'time s',w-86,h-10);g.fillText(yl,l,13);g.fillText(miny.toFixed(yk==='ph'?0:0),8,h-b);g.fillText(maxy.toFixed(yk==='ph'?0:0),8,t+5);drawDeriv()}");
  page += F("function drawDeriv(){var c=document.getElementById('derivCanvas');if(!c)return;var r=c.getBoundingClientRect();if(r.width>0&&c.width!==Math.floor(r.width)){c.width=Math.floor(r.width);c.height=140}var g=c.getContext('2d'),w=c.width,h=c.height,l=58,t=14,ri=18,b=30;g.clearRect(0,0,w,h);g.fillStyle='#071014';g.fillRect(0,0,w,h);g.strokeStyle='#244c59';g.lineWidth=1;g.strokeRect(l,t,w-l-ri,h-t-b);var pts=dosePoints();if(pts.length<3){text('derivInfo','Derivative d(signal) / d(used g) - need >=3 dose-change points');return}var yk=pts[pts.length-1].endpoint==='mV'?'mv':'ph';var derivs=[];for(var i=1;i<pts.length;i++){var dx=pts[i].used_g-pts[i-1].used_g;if(Math.abs(dx)<0.005)continue;var dy=pts[i][yk]-pts[i-1][yk];derivs.push({x:(pts[i].used_g+pts[i-1].used_g)/2,y:dy/dx})}if(derivs.length<2){text('derivInfo','Derivative d(signal) / d(used g) - need more dose separation');return}var minx=derivs[0].x,maxx=derivs[0].x,miny=derivs[0].y,maxy=miny;derivs.forEach(function(d){if(d.x<minx)minx=d.x;if(d.x>maxx)maxx=d.x;if(d.y<miny)miny=d.y;if(d.y>maxy)maxy=d.y});if(maxx===minx)maxx=minx+0.1;if(maxy===miny)maxy=Math.max(miny+1,Math.abs(miny)*0.2);var ypad=(maxy-miny)*0.1;miny-=ypad;maxy+=ypad;var px=function(x){return l+(x-minx)/(maxx-minx)*(w-l-ri)};var py=function(y){return h-b-(y-miny)/(maxy-miny)*(h-t-b)};g.strokeStyle='#48e27b';g.lineWidth=2;g.beginPath();derivs.forEach(function(d,i){var x=px(d.x),y=py(d.y);if(i)g.lineTo(x,y);else g.moveTo(x,y)});g.stroke();var e=currentEqp();if(e){var ex=px(e.used_g),ey=py(e.slope);g.strokeStyle='#ffd15c';g.fillStyle='#ffd15c';g.lineWidth=1;g.beginPath();g.moveTo(ex,t);g.lineTo(ex,h-b);g.stroke();g.beginPath();g.arc(ex,ey,4,0,6.283);g.fill()}g.fillStyle='#8db0bd';g.font='11px Verdana';g.fillText('used g',w-70,h-8);g.fillText('d'+yk+'/dg',l,10);g.fillText(miny.toFixed(yk==='ph'?3:1),4,h-b);g.fillText(maxy.toFixed(yk==='ph'?3:1),4,t+5);text('derivInfo','Derivative d('+yk+')/dg - '+derivs.length+' slope points')}");
  page += F("function chooseEqpAt(ev){if(!lastPlot.length)return;var c=ev.currentTarget,r=c.getBoundingClientRect(),x=(ev.clientX-r.left)*c.width/r.width,y=(ev.clientY-r.top)*c.height/r.height,b=null;lastPlot.forEach(function(pt){var d=(pt.x-x)*(pt.x-x)+(pt.y-y)*(pt.y-y);if(!b||d<b.d)b={d:d,pt:pt}});if(!b)return;var auto=analyzeEqp(),p=b.pt.p,yk=b.pt.yk;eqpManual={mode:'manual',used_g:p.used_g,elapsed_s:p.elapsed_s,signal:p[yk],ph:p.ph,mv:p.mv,endpoint:yk==='mv'?'mV':'pH',slope:auto?auto.slope:0};drawCurve()}");
  page += F("function exportCurve(fmt){if(!curve.length)return;var eqp=currentEqp();var data,mime,name;if(fmt==='json'){data=JSON.stringify({eqp:eqp,points:curve},null,2);mime='application/json';name='titration-data.json'}else{var keys=Object.keys(curve[0]).concat(['eqp_used_g','eqp_signal','eqp_slope','eqp_mode']);data=keys.join(',')+'\\n'+curve.map(function(r){return keys.map(function(k){var v=k==='eqp_used_g'&&eqp?eqp.used_g:k==='eqp_signal'&&eqp?eqp.signal:k==='eqp_slope'&&eqp?eqp.slope:k==='eqp_mode'&&eqp?eqp.mode:r[k];return String(v===undefined?'':v).replace(/\"/g,'\"\"')}).join(',')}).join('\\n');mime='text/csv';name='titration-data.csv'}var a=document.createElement('a');a.href=URL.createObjectURL(new Blob([data],{type:mime}));a.download=name;a.click();setTimeout(function(){URL.revokeObjectURL(a.href)},1000)}");
  page += F("function exportRunRecord(){if(!runRecord)return;var a=document.createElement('a');a.href=URL.createObjectURL(new Blob([JSON.stringify({record:runRecord},null,2)],{type:'application/json'}));a.download='titration-run-record.json';a.click();setTimeout(function(){URL.revokeObjectURL(a.href)},1000)}function reportEscape(v){return String(v===undefined||v===null?'':v).replace(/&/g,'&amp;').replace(/</g,'&lt;').replace(/>/g,'&gt;').replace(/\"/g,'&quot;').replace(/'/g,'&#39;')}function reportPair(label,value){return '<dt>'+reportEscape(label)+'</dt><dd>'+reportEscape(value)+'</dd>'}function printRunReport(){if(!runRecord)return;var final=runRecord.final||{},elapsed=runRecord.startedAt&&runRecord.finishedAt?(new Date(runRecord.finishedAt)-new Date(runRecord.startedAt))/1000:0,confirmation=runRecord.recordStatus==='aborted'?'ABORTED / NOT CONFIRMED':(runRecord.confirmed?'CONFIRMED':'NOT CONFIRMED'),rows='';rows+=reportPair('Record status',runRecord.recordStatus);rows+=reportPair('Confirmation',confirmation);rows+=reportPair('Sample ID',runRecord.metadata&&runRecord.metadata.sampleId);rows+=reportPair('Batch/reference',runRecord.metadata&&runRecord.metadata.batchReference);rows+=reportPair('Operator',runRecord.metadata&&runRecord.metadata.operator);rows+=reportPair('Notes',runRecord.metadata&&runRecord.metadata.notes);rows+=reportPair('Started',runRecord.startedAt);rows+=reportPair('Finished',runRecord.finishedAt);rows+=reportPair('Final state',final.state);rows+=reportPair('Final status',final.status);rows+=reportPair('Result',String(final.resultValue===undefined?'':final.resultValue)+' '+String(final.resultUnit||''));rows+=reportPair('Used mass (g)',final.usedGrams);rows+=reportPair('EQP used mass (g)',final.eqpUsedGrams);rows+=reportPair('EQP signal',final.eqpSignal);rows+=reportPair('EQP slope',final.eqpSlope);rows+=reportPair('Point count',runRecord.points.length);rows+=reportPair('Elapsed time (s)',elapsed.toFixed(1));var report='<!doctype html><title>Titration run record</title><style>body{font:14px sans-serif;margin:24px}dl{display:grid;grid-template-columns:180px 1fr;gap:6px}dt{font-weight:bold}dd{margin:0}pre{white-space:pre-wrap;word-break:break-word}</style><h1>Titration run record</h1><dl>'+rows+'</dl><h2>Method snapshot</h2><pre>'+reportEscape(JSON.stringify(runRecord.methodSnapshot||{},null,2))+'</pre><h2>Device snapshot</h2><pre>'+reportEscape(JSON.stringify(runRecord.deviceSnapshot||{},null,2))+'</pre>';var w=window.open('','_blank');if(!w)return;w.document.write(report);w.document.close();w.focus();w.print()}");
  page += F("async function poll(){try{let r=await fetch('/json',{cache:'no-store'});let d=await r.json();");
  page += F("let mvMode=d.endpoint==='mV';text('primarylabel','Current '+d.endpoint);text('primaryunit',d.endpoint);");
  page += F("text('primaryvalue',d.adc_ok?(mvMode?Number(d.mv).toFixed(0):Number(d.ph).toFixed(2)):(mvMode?'--':'--.--'));");
  page += F("text('secondaryvalue',d.adc_ok?(mvMode?Number(d.ph).toFixed(2):Number(d.mv).toFixed(0)):(mvMode?'--.--':'--'));var se=document.getElementById('secondaryvalue');if(se&&se.parentNode)se.parentNode.lastChild.textContent=mvMode?' pH from ADS1115 A0':' mV from ADS1115 A0';");
  page += F("text('state',d.state);text('status',d.status);");
  page += F("html('pump',d.pump?'<span class=\"warn\">ON</span>':'<span class=\"ok\">STOP</span>');");
  page += F("text('targetunit',d.endpoint);text('target',d.endpoint==='mV'?Number(d.target_mv).toFixed(0):Number(d.target_ph).toFixed(2));text('mvcard',d.adc_ok?Number(d.mv).toFixed(0):'--');text('mode',d.mode);");
  page += F("let used=Number(d.used_g),max=Number(d.max_g);text('used',used.toFixed(1)+' g');text('limit','Limit '+max.toFixed(0)+' g');");
  page += F("text('sample',Number(d.sample_delivered_g).toFixed(1)+' g');text('sampletarget','Target '+Number(d.sample_g).toFixed(1)+' g');");
  page += F("text('titrant',d.titrant);var rd=d.result_formula==='edta_hardness'?1:(d.result_formula==='manual_factor'?4:5);text('resultm',Number(d.result_value).toFixed(rd));text('resultunit',d.result_unit);");
  page += F("text('bottle',d.bottle_g>=0?Number(d.bottle_g).toFixed(1)+' g':'-- g');");
  page += F("html('network','<span>'+d.network+'</span><span>AP '+d.ap_ip+'</span><span>STA '+d.sta_ip+'</span><span>OTA '+(d.ota?'ON':'OFF')+'</span>');");
  page += F("text('netdetail','AP '+d.ap_ip+' / STA '+d.sta_ip+' / OTA host k10-ph-titrator');");
  page += F("let f=document.querySelector('.fill');if(f)f.style.width=Math.max(0,Math.min(100,used/max*100))+'%';");
  page += F("text('titrantgps',Number(d.titrant_gps).toFixed(3));text('samplegps',Number(d.sample_gps).toFixed(3));");
  page += F("recordCurve(d);");
  page += F("observeRunRecord(d);");
  page += F("}catch(e){}}setInterval(poll,2000);");
  page += F("function activateTab(name){var p=document.getElementById('tab-'+name);if(!p)return;document.querySelectorAll('.tab').forEach(function(x){x.classList.toggle('active',x.dataset.tab===name)});document.querySelectorAll('.panel').forEach(function(x){x.classList.remove('active')});p.classList.add('active')}");
  page += F("document.querySelectorAll('.tab').forEach(function(b){b.onclick=function(){activateTab(b.dataset.tab);location.hash=b.dataset.tab}});var initial=(location.hash||'#run').slice(1);activateTab(initial);");
  page += F("['chartX','chartY'].forEach(function(id){var e=document.getElementById(id);if(e)e.onchange=drawCurve});var cv=document.getElementById('curveCanvas');if(cv)cv.onclick=chooseEqpAt;var dv=document.getElementById('derivCanvas');if(dv)dv.onclick=chooseEqpAt;var ea=document.getElementById('eqpAuto');if(ea)ea.onclick=function(){eqpManual=null;drawCurve()};var lp=document.getElementById('learnParams');if(lp)lp.onclick=suggestParams;var cc=document.getElementById('curveClear');if(cc)cc.onclick=function(){curve=[];curveStart=0;eqpManual=null;text('learnInfo','Suggestions wait for at least 4 dose-change points.');drawCurve()};var ec=document.getElementById('curveCsv');if(ec)ec.onclick=function(){exportCurve('csv')};var ej=document.getElementById('curveJson');if(ej)ej.onclick=function(){exportCurve('json')};var er=document.getElementById('recordJson');if(er)er.onclick=exportRunRecord;var pr=document.getElementById('printRunReport');if(pr)pr.onclick=printRunReport;var nr=document.getElementById('newRunRecord');if(nr)nr.onclick=newRunRecord;var rr=document.getElementById('replayRecordInput');if(rr)rr.onchange=function(){importReplayRecord(rr.files&&rr.files[0])};var ra=document.getElementById('replayAnalysisButton');if(ra)ra.onclick=runReplayAnalysis;var lr=document.getElementById('loadSavedRecord');if(lr)lr.onclick=loadSavedRecord;var dr=document.getElementById('deleteSavedRecord');if(dr)dr.onclick=deleteSavedRecord;refreshSavedRecords();renderRunRecord();drawCurve();");
  page += F("var presets={");
  appendMethodPresetJs(page, TitrationMethod::PhEndpoint, true);
  appendMethodPresetJs(page, TitrationMethod::MvEndpoint, true);
  appendMethodPresetJs(page, TitrationMethod::EdtaHardness, true);
  appendMethodPresetJs(page, TitrationMethod::Manual, false);
  page += F("};");
  page += F("function setv(id,v){var e=document.getElementById(id);if(e)e.value=v}var ms=document.getElementById('methodSelect');if(ms)ms.addEventListener('change',function(){var p=presets[ms.value];if(!p)return;setv('endpointSelect',p.endpoint);setv('trendSelect',p.trend);setv('targetPhInput',p.target);setv('targetMvInput',p.target_mv);setv('maxInput',p.max);setv('sampleInput',p.sample);setv('titrantSelect',p.titrant);setv('titrantMInput',p.titrant_m);setv('resultFormulaSelect',p.result_formula);setv('blankInput',p.blank_g);setv('titrantDensityInput',p.titrant_density);setv('sampleDensityInput',p.sample_density);setv('manualFactorInput',p.manual_factor);setv('controlBandInput',p.control_band);setv('stableDeltaInput',p.stable_delta);setv('holdInput',p.hold_s);setv('minSettleInput',p.min_settle_s);setv('maxSettleInput',p.max_settle_s);setv('maxTimeInput',p.max_time_s)});");
  page += F("if(sessionToken())showSession();else showLogin();document.querySelectorAll('.action').forEach(function(b){b.onclick=async function(){try{await apiPost('/action',{cmd:b.dataset.cmd},false);authMessage('Done');poll()}catch(e){authMessage(e.message)}}});document.getElementById('panicButton').onclick=async function(){try{await apiPost('/panic',{},true);authMessage('Pumps stopped');poll()}catch(e){authMessage(e.message)}};document.querySelectorAll('.mutationForm').forEach(function(f){f.addEventListener('submit',async function(e){e.preventDefault();var data=Object.fromEntries(new FormData(f).entries());if(f.id==='manualForm'){data.cmd=e.submitter&&e.submitter.name?e.submitter.value:data.cmd;data.ajax='1'}try{await apiPost(f.action.endsWith('/action')?'/action':'/set',data,false);authMessage('Saved');poll()}catch(err){authMessage(err.message)}})});");
  page += F("async function loginNow(){var input=document.getElementById('loginPassword');try{var d=await apiPost('/login',{password:input.value},true);sessionStorage.setItem('k10_session',d.token);input.value='';showSession();authMessage('Logged in')}catch(err){authMessage(err.message)}}document.getElementById('loginButton').onclick=loginNow;document.getElementById('loginForm').addEventListener('keydown',function(e){if(e.key==='Enter'){e.preventDefault();loginNow()}});document.getElementById('logoutButton').onclick=async function(){try{await apiPost('/logout',{},false)}catch(e){}sessionStorage.removeItem('k10_session');showLogin();authMessage('Logged out')};");
  page += F("async function recoverNow(){var fp=document.getElementById('factoryPassword'),npInput=document.getElementById('newPassword'),cpInput=document.getElementById('confirmPassword'),np=npInput.value,cp=cpInput.value,bytes=new TextEncoder().encode(np).length;if(np!==cp){authMessage('New passwords do not match.');return}if(bytes<10||bytes>64){authMessage('New password must be 10 to 64 UTF-8 bytes.');return}try{await apiPost('/recover',{factory_password:fp.value,new_password:np},true);sessionStorage.removeItem('k10_session');fp.value='';npInput.value='';cpInput.value='';showLogin();authMessage('Recovery complete. Log in with the new password.')}catch(err){authMessage(err.message)}}document.getElementById('recoveryButton').onclick=recoverNow;document.getElementById('recoveryForm').addEventListener('keydown',function(e){if(e.key==='Enter'){e.preventDefault();recoverNow()}});");
  page += F("document.getElementById('otaForm').addEventListener('submit',async function(e){e.preventDefault();var fd=new FormData(e.currentTarget),headers={},token=sessionToken();if(token)headers['X-Session-Token']=token;try{var response=await fetch('/ota',{method:'POST',headers:headers,body:fd});var data=await response.json();if(response.status===401){sessionStorage.removeItem('k10_session');showLogin()}if(response.status===403)authMessage('Request is not permitted in the current state.');if(response.status===429)throw new Error('Too many attempts. Try again later.');if(!response.ok)throw new Error(data.message||data.code||'Request failed');authMessage('Firmware uploaded')}catch(err){authMessage(err.message)}});");
  page += F("function retainSavedRecords(records){return records.slice().sort(function(a,b){return String(b.savedAt).localeCompare(String(a.savedAt))}).slice(0,50)}");
